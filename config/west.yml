## config/west.yml
```yaml
manifest:
  remotes:
    - name: zmkfirmware
      url-base: https://github.com/zmkfirmware
    - name: flavioarcega
      url-base: https://github.com/flavioarcega
  projects:
    - name: zmk
      remote: flavioarcega
      revision: main
      import: app/west.yml
  self:
    path: config
```
